// generated by openMikroBootloader xml2inc
 
{$IFDEF P32MX110F016B}
  __ombFLASH_START      = $1D000000;
  __ombFLASH_SIZE       = $00003FFF;
  __ombBOOTFLASH_START  = $1FC00000;
  __ombBOOTFLASH_SIZE   = $00000BEF;
  __ombEEPROM_START     = $00000000;
  __ombEEPROM_SIZE      = $00000000;
  __ombCONFIG           = $1FC00BF0;
  __ombERASE_BLOCK_SIZE = $00000000;
  __ombWRITE_BLOCK_SIZE = $00000000;
{$ENDIF}
 
{$IFDEF P32MX110F016C}
  __ombFLASH_START      = $1D000000;
  __ombFLASH_SIZE       = $00003FFF;
  __ombBOOTFLASH_START  = $1FC00000;
  __ombBOOTFLASH_SIZE   = $00000BEF;
  __ombEEPROM_START     = $00000000;
  __ombEEPROM_SIZE      = $00000000;
  __ombCONFIG           = $1FC00BF0;
  __ombERASE_BLOCK_SIZE = $00000000;
  __ombWRITE_BLOCK_SIZE = $00000000;
{$ENDIF}
 
{$IFDEF P32MX110F016D}
  __ombFLASH_START      = $1D000000;
  __ombFLASH_SIZE       = $00003FFF;
  __ombBOOTFLASH_START  = $1FC00000;
  __ombBOOTFLASH_SIZE   = $00000BEF;
  __ombEEPROM_START     = $00000000;
  __ombEEPROM_SIZE      = $00000000;
  __ombCONFIG           = $1FC00BF0;
  __ombERASE_BLOCK_SIZE = $00000000;
  __ombWRITE_BLOCK_SIZE = $00000000;
{$ENDIF}
 
{$IFDEF P32MX120F032B}
  __ombFLASH_START      = $1D000000;
  __ombFLASH_SIZE       = $00007FFF;
  __ombBOOTFLASH_START  = $1FC00000;
  __ombBOOTFLASH_SIZE   = $00000BEF;
  __ombEEPROM_START     = $00000000;
  __ombEEPROM_SIZE      = $00000000;
  __ombCONFIG           = $1FC00BF0;
  __ombERASE_BLOCK_SIZE = $00000000;
  __ombWRITE_BLOCK_SIZE = $00000000;
{$ENDIF}
 
{$IFDEF P32MX120F032C}
  __ombFLASH_START      = $1D000000;
  __ombFLASH_SIZE       = $00007FFF;
  __ombBOOTFLASH_START  = $1FC00000;
  __ombBOOTFLASH_SIZE   = $00000BEF;
  __ombEEPROM_START     = $00000000;
  __ombEEPROM_SIZE      = $00000000;
  __ombCONFIG           = $1FC00BF0;
  __ombERASE_BLOCK_SIZE = $00000000;
  __ombWRITE_BLOCK_SIZE = $00000000;
{$ENDIF}
 
{$IFDEF P32MX120F032D}
  __ombFLASH_START      = $1D000000;
  __ombFLASH_SIZE       = $00007FFF;
  __ombBOOTFLASH_START  = $1FC00000;
  __ombBOOTFLASH_SIZE   = $00000BEF;
  __ombEEPROM_START     = $00000000;
  __ombEEPROM_SIZE      = $00000000;
  __ombCONFIG           = $1FC00BF0;
  __ombERASE_BLOCK_SIZE = $00000000;
  __ombWRITE_BLOCK_SIZE = $00000000;
{$ENDIF}
 
{$IFDEF P32MX130F064B}
  __ombFLASH_START      = $1D000000;
  __ombFLASH_SIZE       = $0000FFFF;
  __ombBOOTFLASH_START  = $1FC00000;
  __ombBOOTFLASH_SIZE   = $00000BEF;
  __ombEEPROM_START     = $00000000;
  __ombEEPROM_SIZE      = $00000000;
  __ombCONFIG           = $1FC00BF0;
  __ombERASE_BLOCK_SIZE = $00000000;
  __ombWRITE_BLOCK_SIZE = $00000000;
{$ENDIF}
 
{$IFDEF P32MX130F064C}
  __ombFLASH_START      = $1D000000;
  __ombFLASH_SIZE       = $0000FFFF;
  __ombBOOTFLASH_START  = $1FC00000;
  __ombBOOTFLASH_SIZE   = $00000BEF;
  __ombEEPROM_START     = $00000000;
  __ombEEPROM_SIZE      = $00000000;
  __ombCONFIG           = $1FC00BF0;
  __ombERASE_BLOCK_SIZE = $00000000;
  __ombWRITE_BLOCK_SIZE = $00000000;
{$ENDIF}
 
{$IFDEF P32MX130F064D}
  __ombFLASH_START      = $1D000000;
  __ombFLASH_SIZE       = $0000FFFF;
  __ombBOOTFLASH_START  = $1FC00000;
  __ombBOOTFLASH_SIZE   = $00000BEF;
  __ombEEPROM_START     = $00000000;
  __ombEEPROM_SIZE      = $00000000;
  __ombCONFIG           = $1FC00BF0;
  __ombERASE_BLOCK_SIZE = $00000000;
  __ombWRITE_BLOCK_SIZE = $00000000;
{$ENDIF}
 
{$IFDEF P32MX150F128B}
  __ombFLASH_START      = $1D000000;
  __ombFLASH_SIZE       = $0001FFFF;
  __ombBOOTFLASH_START  = $1FC00000;
  __ombBOOTFLASH_SIZE   = $00000BEF;
  __ombEEPROM_START     = $00000000;
  __ombEEPROM_SIZE      = $00000000;
  __ombCONFIG           = $1FC00BF0;
  __ombERASE_BLOCK_SIZE = $00000000;
  __ombWRITE_BLOCK_SIZE = $00000000;
{$ENDIF}
 
{$IFDEF P32MX150F128C}
  __ombFLASH_START      = $1D000000;
  __ombFLASH_SIZE       = $0001FFFF;
  __ombBOOTFLASH_START  = $1FC00000;
  __ombBOOTFLASH_SIZE   = $00000BEF;
  __ombEEPROM_START     = $00000000;
  __ombEEPROM_SIZE      = $00000000;
  __ombCONFIG           = $1FC00BF0;
  __ombERASE_BLOCK_SIZE = $00000000;
  __ombWRITE_BLOCK_SIZE = $00000000;
{$ENDIF}
 
{$IFDEF P32MX150F128D}
  __ombFLASH_START      = $1D000000;
  __ombFLASH_SIZE       = $0001FFFF;
  __ombBOOTFLASH_START  = $1FC00000;
  __ombBOOTFLASH_SIZE   = $00000BEF;
  __ombEEPROM_START     = $00000000;
  __ombEEPROM_SIZE      = $00000000;
  __ombCONFIG           = $1FC00BF0;
  __ombERASE_BLOCK_SIZE = $00000000;
  __ombWRITE_BLOCK_SIZE = $00000000;
{$ENDIF}
 
{$IFDEF P32MX210F016B}
  __ombFLASH_START      = $1D000000;
  __ombFLASH_SIZE       = $00003FFF;
  __ombBOOTFLASH_START  = $1FC00000;
  __ombBOOTFLASH_SIZE   = $00000BEF;
  __ombEEPROM_START     = $00000000;
  __ombEEPROM_SIZE      = $00000000;
  __ombCONFIG           = $1FC00BF0;
  __ombERASE_BLOCK_SIZE = $00000000;
  __ombWRITE_BLOCK_SIZE = $00000000;
{$ENDIF}
 
{$IFDEF P32MX210F016C}
  __ombFLASH_START      = $1D000000;
  __ombFLASH_SIZE       = $00003FFF;
  __ombBOOTFLASH_START  = $1FC00000;
  __ombBOOTFLASH_SIZE   = $00000BEF;
  __ombEEPROM_START     = $00000000;
  __ombEEPROM_SIZE      = $00000000;
  __ombCONFIG           = $1FC00BF0;
  __ombERASE_BLOCK_SIZE = $00000000;
  __ombWRITE_BLOCK_SIZE = $00000000;
{$ENDIF}
 
{$IFDEF P32MX210F016D}
  __ombFLASH_START      = $1D000000;
  __ombFLASH_SIZE       = $00003FFF;
  __ombBOOTFLASH_START  = $1FC00000;
  __ombBOOTFLASH_SIZE   = $00000BEF;
  __ombEEPROM_START     = $00000000;
  __ombEEPROM_SIZE      = $00000000;
  __ombCONFIG           = $1FC00BF0;
  __ombERASE_BLOCK_SIZE = $00000000;
  __ombWRITE_BLOCK_SIZE = $00000000;
{$ENDIF}
 
{$IFDEF P32MX220F032B}
  __ombFLASH_START      = $1D000000;
  __ombFLASH_SIZE       = $00007FFF;
  __ombBOOTFLASH_START  = $1FC00000;
  __ombBOOTFLASH_SIZE   = $00000BEF;
  __ombEEPROM_START     = $00000000;
  __ombEEPROM_SIZE      = $00000000;
  __ombCONFIG           = $1FC00BF0;
  __ombERASE_BLOCK_SIZE = $00000000;
  __ombWRITE_BLOCK_SIZE = $00000000;
{$ENDIF}
 
{$IFDEF P32MX220F032C}
  __ombFLASH_START      = $1D000000;
  __ombFLASH_SIZE       = $00007FFF;
  __ombBOOTFLASH_START  = $1FC00000;
  __ombBOOTFLASH_SIZE   = $00000BEF;
  __ombEEPROM_START     = $00000000;
  __ombEEPROM_SIZE      = $00000000;
  __ombCONFIG           = $1FC00BF0;
  __ombERASE_BLOCK_SIZE = $00000000;
  __ombWRITE_BLOCK_SIZE = $00000000;
{$ENDIF}
 
{$IFDEF P32MX220F032D}
  __ombFLASH_START      = $1D000000;
  __ombFLASH_SIZE       = $00007FFF;
  __ombBOOTFLASH_START  = $1FC00000;
  __ombBOOTFLASH_SIZE   = $00000BEF;
  __ombEEPROM_START     = $00000000;
  __ombEEPROM_SIZE      = $00000000;
  __ombCONFIG           = $1FC00BF0;
  __ombERASE_BLOCK_SIZE = $00000000;
  __ombWRITE_BLOCK_SIZE = $00000000;
{$ENDIF}
 
{$IFDEF P32MX230F064B}
  __ombFLASH_START      = $1D000000;
  __ombFLASH_SIZE       = $0000FFFF;
  __ombBOOTFLASH_START  = $1FC00000;
  __ombBOOTFLASH_SIZE   = $00000BEF;
  __ombEEPROM_START     = $00000000;
  __ombEEPROM_SIZE      = $00000000;
  __ombCONFIG           = $1FC00BF0;
  __ombERASE_BLOCK_SIZE = $00000000;
  __ombWRITE_BLOCK_SIZE = $00000000;
{$ENDIF}
 
{$IFDEF P32MX230F064C}
  __ombFLASH_START      = $1D000000;
  __ombFLASH_SIZE       = $0000FFFF;
  __ombBOOTFLASH_START  = $1FC00000;
  __ombBOOTFLASH_SIZE   = $00000BEF;
  __ombEEPROM_START     = $00000000;
  __ombEEPROM_SIZE      = $00000000;
  __ombCONFIG           = $1FC00BF0;
  __ombERASE_BLOCK_SIZE = $00000000;
  __ombWRITE_BLOCK_SIZE = $00000000;
{$ENDIF}
 
{$IFDEF P32MX230F064D}
  __ombFLASH_START      = $1D000000;
  __ombFLASH_SIZE       = $0000FFFF;
  __ombBOOTFLASH_START  = $1FC00000;
  __ombBOOTFLASH_SIZE   = $00000BEF;
  __ombEEPROM_START     = $00000000;
  __ombEEPROM_SIZE      = $00000000;
  __ombCONFIG           = $1FC00BF0;
  __ombERASE_BLOCK_SIZE = $00000000;
  __ombWRITE_BLOCK_SIZE = $00000000;
{$ENDIF}
 
{$IFDEF P32MX250F128B}
  __ombFLASH_START      = $1D000000;
  __ombFLASH_SIZE       = $0001FFFF;
  __ombBOOTFLASH_START  = $1FC00000;
  __ombBOOTFLASH_SIZE   = $00000BEF;
  __ombEEPROM_START     = $00000000;
  __ombEEPROM_SIZE      = $00000000;
  __ombCONFIG           = $1FC00BF0;
  __ombERASE_BLOCK_SIZE = $00000000;
  __ombWRITE_BLOCK_SIZE = $00000000;
{$ENDIF}
 
{$IFDEF P32MX250F128C}
  __ombFLASH_START      = $1D000000;
  __ombFLASH_SIZE       = $0001FFFF;
  __ombBOOTFLASH_START  = $1FC00000;
  __ombBOOTFLASH_SIZE   = $00000BEF;
  __ombEEPROM_START     = $00000000;
  __ombEEPROM_SIZE      = $00000000;
  __ombCONFIG           = $1FC00BF0;
  __ombERASE_BLOCK_SIZE = $00000000;
  __ombWRITE_BLOCK_SIZE = $00000000;
{$ENDIF}
 
{$IFDEF P32MX250F128D}
  __ombFLASH_START      = $1D000000;
  __ombFLASH_SIZE       = $0001FFFF;
  __ombBOOTFLASH_START  = $1FC00000;
  __ombBOOTFLASH_SIZE   = $00000BEF;
  __ombEEPROM_START     = $00000000;
  __ombEEPROM_SIZE      = $00000000;
  __ombCONFIG           = $1FC00BF0;
  __ombERASE_BLOCK_SIZE = $00000000;
  __ombWRITE_BLOCK_SIZE = $00000000;
{$ENDIF}
 
{$IFDEF P32MX320F032H}
  __ombFLASH_START      = $1D000000;
  __ombFLASH_SIZE       = $00007FFF;
  __ombBOOTFLASH_START  = $1FC00000;
  __ombBOOTFLASH_SIZE   = $00002FEF;
  __ombEEPROM_START     = $00000000;
  __ombEEPROM_SIZE      = $00000000;
  __ombCONFIG           = $1FC02FF0;
  __ombERASE_BLOCK_SIZE = $00000000;
  __ombWRITE_BLOCK_SIZE = $00000000;
{$ENDIF}
 
{$IFDEF P32MX320F064H}
  __ombFLASH_START      = $1D000000;
  __ombFLASH_SIZE       = $0000FFFF;
  __ombBOOTFLASH_START  = $1FC00000;
  __ombBOOTFLASH_SIZE   = $00002FEF;
  __ombEEPROM_START     = $00000000;
  __ombEEPROM_SIZE      = $00000000;
  __ombCONFIG           = $1FC02FF0;
  __ombERASE_BLOCK_SIZE = $00000000;
  __ombWRITE_BLOCK_SIZE = $00000000;
{$ENDIF}
 
{$IFDEF P32MX320F128H}
  __ombFLASH_START      = $1D000000;
  __ombFLASH_SIZE       = $0001FFFF;
  __ombBOOTFLASH_START  = $1FC00000;
  __ombBOOTFLASH_SIZE   = $00002FEF;
  __ombEEPROM_START     = $00000000;
  __ombEEPROM_SIZE      = $00000000;
  __ombCONFIG           = $1FC02FF0;
  __ombERASE_BLOCK_SIZE = $00000000;
  __ombWRITE_BLOCK_SIZE = $00000000;
{$ENDIF}
 
{$IFDEF P32MX320F128L}
  __ombFLASH_START      = $1D000000;
  __ombFLASH_SIZE       = $0001FFFF;
  __ombBOOTFLASH_START  = $1FC00000;
  __ombBOOTFLASH_SIZE   = $00002FEF;
  __ombEEPROM_START     = $00000000;
  __ombEEPROM_SIZE      = $00000000;
  __ombCONFIG           = $1FC02FF0;
  __ombERASE_BLOCK_SIZE = $00000000;
  __ombWRITE_BLOCK_SIZE = $00000000;
{$ENDIF}
 
{$IFDEF P32MX340F128H}
  __ombFLASH_START      = $1D000000;
  __ombFLASH_SIZE       = $0001FFFF;
  __ombBOOTFLASH_START  = $1FC00000;
  __ombBOOTFLASH_SIZE   = $00002FEF;
  __ombEEPROM_START     = $00000000;
  __ombEEPROM_SIZE      = $00000000;
  __ombCONFIG           = $1FC02FF0;
  __ombERASE_BLOCK_SIZE = $00000000;
  __ombWRITE_BLOCK_SIZE = $00000000;
{$ENDIF}
 
{$IFDEF P32MX340F128L}
  __ombFLASH_START      = $1D000000;
  __ombFLASH_SIZE       = $0001FFFF;
  __ombBOOTFLASH_START  = $1FC00000;
  __ombBOOTFLASH_SIZE   = $00002FEF;
  __ombEEPROM_START     = $00000000;
  __ombEEPROM_SIZE      = $00000000;
  __ombCONFIG           = $1FC02FF0;
  __ombERASE_BLOCK_SIZE = $00000000;
  __ombWRITE_BLOCK_SIZE = $00000000;
{$ENDIF}
 
{$IFDEF P32MX340F256H}
  __ombFLASH_START      = $1D000000;
  __ombFLASH_SIZE       = $0003FFFF;
  __ombBOOTFLASH_START  = $1FC00000;
  __ombBOOTFLASH_SIZE   = $00002FEF;
  __ombEEPROM_START     = $00000000;
  __ombEEPROM_SIZE      = $00000000;
  __ombCONFIG           = $1FC02FF0;
  __ombERASE_BLOCK_SIZE = $00000000;
  __ombWRITE_BLOCK_SIZE = $00000000;
{$ENDIF}
 
{$IFDEF P32MX340F512H}
  __ombFLASH_START      = $1D000000;
  __ombFLASH_SIZE       = $0007FFFF;
  __ombBOOTFLASH_START  = $1FC00000;
  __ombBOOTFLASH_SIZE   = $00002FEF;
  __ombEEPROM_START     = $00000000;
  __ombEEPROM_SIZE      = $00000000;
  __ombCONFIG           = $1FC02FF0;
  __ombERASE_BLOCK_SIZE = $00000000;
  __ombWRITE_BLOCK_SIZE = $00000000;
{$ENDIF}
 
{$IFDEF P32MX360F256L}
  __ombFLASH_START      = $1D000000;
  __ombFLASH_SIZE       = $0003FFFF;
  __ombBOOTFLASH_START  = $1FC00000;
  __ombBOOTFLASH_SIZE   = $00002FEF;
  __ombEEPROM_START     = $00000000;
  __ombEEPROM_SIZE      = $00000000;
  __ombCONFIG           = $1FC02FF0;
  __ombERASE_BLOCK_SIZE = $00000000;
  __ombWRITE_BLOCK_SIZE = $00000000;
{$ENDIF}
 
{$IFDEF P32MX360F512L}
  __ombFLASH_START      = $1D000000;
  __ombFLASH_SIZE       = $0007FFFF;
  __ombBOOTFLASH_START  = $1FC00000;
  __ombBOOTFLASH_SIZE   = $00002FEF;
  __ombEEPROM_START     = $00000000;
  __ombEEPROM_SIZE      = $00000000;
  __ombCONFIG           = $1FC02FF0;
  __ombERASE_BLOCK_SIZE = $00000000;
  __ombWRITE_BLOCK_SIZE = $00000000;
{$ENDIF}
 
{$IFDEF P32MX420F032H}
  __ombFLASH_START      = $1D000000;
  __ombFLASH_SIZE       = $00007FFF;
  __ombBOOTFLASH_START  = $1FC00000;
  __ombBOOTFLASH_SIZE   = $00002FEF;
  __ombEEPROM_START     = $00000000;
  __ombEEPROM_SIZE      = $00000000;
  __ombCONFIG           = $1FC02FF0;
  __ombERASE_BLOCK_SIZE = $00000000;
  __ombWRITE_BLOCK_SIZE = $00000000;
{$ENDIF}
 
{$IFDEF P32MX440F128H}
  __ombFLASH_START      = $1D000000;
  __ombFLASH_SIZE       = $0001FFFF;
  __ombBOOTFLASH_START  = $1FC00000;
  __ombBOOTFLASH_SIZE   = $00002FEF;
  __ombEEPROM_START     = $00000000;
  __ombEEPROM_SIZE      = $00000000;
  __ombCONFIG           = $1FC02FF0;
  __ombERASE_BLOCK_SIZE = $00000000;
  __ombWRITE_BLOCK_SIZE = $00000000;
{$ENDIF}
 
{$IFDEF P32MX440F128L}
  __ombFLASH_START      = $1D000000;
  __ombFLASH_SIZE       = $0001FFFF;
  __ombBOOTFLASH_START  = $1FC00000;
  __ombBOOTFLASH_SIZE   = $00002FEF;
  __ombEEPROM_START     = $00000000;
  __ombEEPROM_SIZE      = $00000000;
  __ombCONFIG           = $1FC02FF0;
  __ombERASE_BLOCK_SIZE = $00000000;
  __ombWRITE_BLOCK_SIZE = $00000000;
{$ENDIF}
 
{$IFDEF P32MX440F256H}
  __ombFLASH_START      = $1D000000;
  __ombFLASH_SIZE       = $0003FFFF;
  __ombBOOTFLASH_START  = $1FC00000;
  __ombBOOTFLASH_SIZE   = $00002FEF;
  __ombEEPROM_START     = $00000000;
  __ombEEPROM_SIZE      = $00000000;
  __ombCONFIG           = $1FC02FF0;
  __ombERASE_BLOCK_SIZE = $00000000;
  __ombWRITE_BLOCK_SIZE = $00000000;
{$ENDIF}
 
{$IFDEF P32MX440F512H}
  __ombFLASH_START      = $1D000000;
  __ombFLASH_SIZE       = $0007FFFF;
  __ombBOOTFLASH_START  = $1FC00000;
  __ombBOOTFLASH_SIZE   = $00002FEF;
  __ombEEPROM_START     = $00000000;
  __ombEEPROM_SIZE      = $00000000;
  __ombCONFIG           = $1FC02FF0;
  __ombERASE_BLOCK_SIZE = $00000000;
  __ombWRITE_BLOCK_SIZE = $00000000;
{$ENDIF}
 
{$IFDEF P32MX460F256L}
  __ombFLASH_START      = $1D000000;
  __ombFLASH_SIZE       = $0003FFFF;
  __ombBOOTFLASH_START  = $1FC00000;
  __ombBOOTFLASH_SIZE   = $00002FEF;
  __ombEEPROM_START     = $00000000;
  __ombEEPROM_SIZE      = $00000000;
  __ombCONFIG           = $1FC02FF0;
  __ombERASE_BLOCK_SIZE = $00000000;
  __ombWRITE_BLOCK_SIZE = $00000000;
{$ENDIF}
 
{$IFDEF P32MX460F512L}
  __ombFLASH_START      = $1D000000;
  __ombFLASH_SIZE       = $0007FFFF;
  __ombBOOTFLASH_START  = $1FC00000;
  __ombBOOTFLASH_SIZE   = $00002FEF;
  __ombEEPROM_START     = $00000000;
  __ombEEPROM_SIZE      = $00000000;
  __ombCONFIG           = $1FC02FF0;
  __ombERASE_BLOCK_SIZE = $00000000;
  __ombWRITE_BLOCK_SIZE = $00000000;
{$ENDIF}
 
{$IFDEF P32MX534F064H}
  __ombFLASH_START      = $1D000000;
  __ombFLASH_SIZE       = $0000FFFF;
  __ombBOOTFLASH_START  = $1FC00000;
  __ombBOOTFLASH_SIZE   = $00002FEF;
  __ombEEPROM_START     = $00000000;
  __ombEEPROM_SIZE      = $00000000;
  __ombCONFIG           = $1FC02FF0;
  __ombERASE_BLOCK_SIZE = $00000000;
  __ombWRITE_BLOCK_SIZE = $00000000;
{$ENDIF}
 
{$IFDEF P32MX534F064L}
  __ombFLASH_START      = $1D000000;
  __ombFLASH_SIZE       = $0000FFFF;
  __ombBOOTFLASH_START  = $1FC00000;
  __ombBOOTFLASH_SIZE   = $00002FEF;
  __ombEEPROM_START     = $00000000;
  __ombEEPROM_SIZE      = $00000000;
  __ombCONFIG           = $1FC02FF0;
  __ombERASE_BLOCK_SIZE = $00000000;
  __ombWRITE_BLOCK_SIZE = $00000000;
{$ENDIF}
 
{$IFDEF P32MX564F064H}
  __ombFLASH_START      = $1D000000;
  __ombFLASH_SIZE       = $0000FFFF;
  __ombBOOTFLASH_START  = $1FC00000;
  __ombBOOTFLASH_SIZE   = $00002FEF;
  __ombEEPROM_START     = $00000000;
  __ombEEPROM_SIZE      = $00000000;
  __ombCONFIG           = $1FC02FF0;
  __ombERASE_BLOCK_SIZE = $00000000;
  __ombWRITE_BLOCK_SIZE = $00000000;
{$ENDIF}
 
{$IFDEF P32MX564F064L}
  __ombFLASH_START      = $1D000000;
  __ombFLASH_SIZE       = $0000FFFF;
  __ombBOOTFLASH_START  = $1FC00000;
  __ombBOOTFLASH_SIZE   = $00002FEF;
  __ombEEPROM_START     = $00000000;
  __ombEEPROM_SIZE      = $00000000;
  __ombCONFIG           = $1FC02FF0;
  __ombERASE_BLOCK_SIZE = $00000000;
  __ombWRITE_BLOCK_SIZE = $00000000;
{$ENDIF}
 
{$IFDEF P32MX564F128H}
  __ombFLASH_START      = $1D000000;
  __ombFLASH_SIZE       = $0001FFFF;
  __ombBOOTFLASH_START  = $1FC00000;
  __ombBOOTFLASH_SIZE   = $00002FEF;
  __ombEEPROM_START     = $00000000;
  __ombEEPROM_SIZE      = $00000000;
  __ombCONFIG           = $1FC02FF0;
  __ombERASE_BLOCK_SIZE = $00000000;
  __ombWRITE_BLOCK_SIZE = $00000000;
{$ENDIF}
 
{$IFDEF P32MX564F128L}
  __ombFLASH_START      = $1D000000;
  __ombFLASH_SIZE       = $0001FFFF;
  __ombBOOTFLASH_START  = $1FC00000;
  __ombBOOTFLASH_SIZE   = $00002FEF;
  __ombEEPROM_START     = $00000000;
  __ombEEPROM_SIZE      = $00000000;
  __ombCONFIG           = $1FC02FF0;
  __ombERASE_BLOCK_SIZE = $00000000;
  __ombWRITE_BLOCK_SIZE = $00000000;
{$ENDIF}
 
{$IFDEF P32MX575F256H}
  __ombFLASH_START      = $1D000000;
  __ombFLASH_SIZE       = $0003FFFF;
  __ombBOOTFLASH_START  = $1FC00000;
  __ombBOOTFLASH_SIZE   = $00002FEF;
  __ombEEPROM_START     = $00000000;
  __ombEEPROM_SIZE      = $00000000;
  __ombCONFIG           = $1FC02FF0;
  __ombERASE_BLOCK_SIZE = $00000000;
  __ombWRITE_BLOCK_SIZE = $00000000;
{$ENDIF}
 
{$IFDEF P32MX575F256L}
  __ombFLASH_START      = $1D000000;
  __ombFLASH_SIZE       = $0003FFFF;
  __ombBOOTFLASH_START  = $1FC00000;
  __ombBOOTFLASH_SIZE   = $00002FEF;
  __ombEEPROM_START     = $00000000;
  __ombEEPROM_SIZE      = $00000000;
  __ombCONFIG           = $1FC02FF0;
  __ombERASE_BLOCK_SIZE = $00000000;
  __ombWRITE_BLOCK_SIZE = $00000000;
{$ENDIF}
 
{$IFDEF P32MX575F512H}
  __ombFLASH_START      = $1D000000;
  __ombFLASH_SIZE       = $0007FFFF;
  __ombBOOTFLASH_START  = $1FC00000;
  __ombBOOTFLASH_SIZE   = $00002FEF;
  __ombEEPROM_START     = $00000000;
  __ombEEPROM_SIZE      = $00000000;
  __ombCONFIG           = $1FC02FF0;
  __ombERASE_BLOCK_SIZE = $00000000;
  __ombWRITE_BLOCK_SIZE = $00000000;
{$ENDIF}
 
{$IFDEF P32MX575F512L}
  __ombFLASH_START      = $1D000000;
  __ombFLASH_SIZE       = $0007FFFF;
  __ombBOOTFLASH_START  = $1FC00000;
  __ombBOOTFLASH_SIZE   = $00002FEF;
  __ombEEPROM_START     = $00000000;
  __ombEEPROM_SIZE      = $00000000;
  __ombCONFIG           = $1FC02FF0;
  __ombERASE_BLOCK_SIZE = $00000000;
  __ombWRITE_BLOCK_SIZE = $00000000;
{$ENDIF}
 
{$IFDEF P32MX664F064H}
  __ombFLASH_START      = $1D000000;
  __ombFLASH_SIZE       = $0000FFFF;
  __ombBOOTFLASH_START  = $1FC00000;
  __ombBOOTFLASH_SIZE   = $00002FEF;
  __ombEEPROM_START     = $00000000;
  __ombEEPROM_SIZE      = $00000000;
  __ombCONFIG           = $1FC02FF0;
  __ombERASE_BLOCK_SIZE = $00000000;
  __ombWRITE_BLOCK_SIZE = $00000000;
{$ENDIF}
 
{$IFDEF P32MX664F064L}
  __ombFLASH_START      = $1D000000;
  __ombFLASH_SIZE       = $0000FFFF;
  __ombBOOTFLASH_START  = $1FC00000;
  __ombBOOTFLASH_SIZE   = $00002FEF;
  __ombEEPROM_START     = $00000000;
  __ombEEPROM_SIZE      = $00000000;
  __ombCONFIG           = $1FC02FF0;
  __ombERASE_BLOCK_SIZE = $00000000;
  __ombWRITE_BLOCK_SIZE = $00000000;
{$ENDIF}
 
{$IFDEF P32MX664F128H}
  __ombFLASH_START      = $1D000000;
  __ombFLASH_SIZE       = $0001FFFF;
  __ombBOOTFLASH_START  = $1FC00000;
  __ombBOOTFLASH_SIZE   = $00002FEF;
  __ombEEPROM_START     = $00000000;
  __ombEEPROM_SIZE      = $00000000;
  __ombCONFIG           = $1FC02FF0;
  __ombERASE_BLOCK_SIZE = $00000000;
  __ombWRITE_BLOCK_SIZE = $00000000;
{$ENDIF}
 
{$IFDEF P32MX664F128L}
  __ombFLASH_START      = $1D000000;
  __ombFLASH_SIZE       = $0001FFFF;
  __ombBOOTFLASH_START  = $1FC00000;
  __ombBOOTFLASH_SIZE   = $00002FEF;
  __ombEEPROM_START     = $00000000;
  __ombEEPROM_SIZE      = $00000000;
  __ombCONFIG           = $1FC02FF0;
  __ombERASE_BLOCK_SIZE = $00000000;
  __ombWRITE_BLOCK_SIZE = $00000000;
{$ENDIF}
 
{$IFDEF P32MX675F256H}
  __ombFLASH_START      = $1D000000;
  __ombFLASH_SIZE       = $0003FFFF;
  __ombBOOTFLASH_START  = $1FC00000;
  __ombBOOTFLASH_SIZE   = $00002FEF;
  __ombEEPROM_START     = $00000000;
  __ombEEPROM_SIZE      = $00000000;
  __ombCONFIG           = $1FC02FF0;
  __ombERASE_BLOCK_SIZE = $00000000;
  __ombWRITE_BLOCK_SIZE = $00000000;
{$ENDIF}
 
{$IFDEF P32MX675F256L}
  __ombFLASH_START      = $1D000000;
  __ombFLASH_SIZE       = $0003FFFF;
  __ombBOOTFLASH_START  = $1FC00000;
  __ombBOOTFLASH_SIZE   = $00002FEF;
  __ombEEPROM_START     = $00000000;
  __ombEEPROM_SIZE      = $00000000;
  __ombCONFIG           = $1FC02FF0;
  __ombERASE_BLOCK_SIZE = $00000000;
  __ombWRITE_BLOCK_SIZE = $00000000;
{$ENDIF}
 
{$IFDEF P32MX675F512H}
  __ombFLASH_START      = $1D000000;
  __ombFLASH_SIZE       = $0007FFFF;
  __ombBOOTFLASH_START  = $1FC00000;
  __ombBOOTFLASH_SIZE   = $00002FEF;
  __ombEEPROM_START     = $00000000;
  __ombEEPROM_SIZE      = $00000000;
  __ombCONFIG           = $1FC02FF0;
  __ombERASE_BLOCK_SIZE = $00000000;
  __ombWRITE_BLOCK_SIZE = $00000000;
{$ENDIF}
 
{$IFDEF P32MX675F512L}
  __ombFLASH_START      = $1D000000;
  __ombFLASH_SIZE       = $0007FFFF;
  __ombBOOTFLASH_START  = $1FC00000;
  __ombBOOTFLASH_SIZE   = $00002FEF;
  __ombEEPROM_START     = $00000000;
  __ombEEPROM_SIZE      = $00000000;
  __ombCONFIG           = $1FC02FF0;
  __ombERASE_BLOCK_SIZE = $00000000;
  __ombWRITE_BLOCK_SIZE = $00000000;
{$ENDIF}
 
{$IFDEF P32MX695F512H}
  __ombFLASH_START      = $1D000000;
  __ombFLASH_SIZE       = $0007FFFF;
  __ombBOOTFLASH_START  = $1FC00000;
  __ombBOOTFLASH_SIZE   = $00002FEF;
  __ombEEPROM_START     = $00000000;
  __ombEEPROM_SIZE      = $00000000;
  __ombCONFIG           = $1FC02FF0;
  __ombERASE_BLOCK_SIZE = $00000000;
  __ombWRITE_BLOCK_SIZE = $00000000;
{$ENDIF}
 
{$IFDEF P32MX695F512L}
  __ombFLASH_START      = $1D000000;
  __ombFLASH_SIZE       = $0007FFFF;
  __ombBOOTFLASH_START  = $1FC00000;
  __ombBOOTFLASH_SIZE   = $00002FEF;
  __ombEEPROM_START     = $00000000;
  __ombEEPROM_SIZE      = $00000000;
  __ombCONFIG           = $1FC02FF0;
  __ombERASE_BLOCK_SIZE = $00000000;
  __ombWRITE_BLOCK_SIZE = $00000000;
{$ENDIF}
 
{$IFDEF P32MX764F128H}
  __ombFLASH_START      = $1D000000;
  __ombFLASH_SIZE       = $0001FFFF;
  __ombBOOTFLASH_START  = $1FC00000;
  __ombBOOTFLASH_SIZE   = $00002FEF;
  __ombEEPROM_START     = $00000000;
  __ombEEPROM_SIZE      = $00000000;
  __ombCONFIG           = $1FC02FF0;
  __ombERASE_BLOCK_SIZE = $00000000;
  __ombWRITE_BLOCK_SIZE = $00000000;
{$ENDIF}
 
{$IFDEF P32MX764F128L}
  __ombFLASH_START      = $1D000000;
  __ombFLASH_SIZE       = $0001FFFF;
  __ombBOOTFLASH_START  = $1FC00000;
  __ombBOOTFLASH_SIZE   = $00002FEF;
  __ombEEPROM_START     = $00000000;
  __ombEEPROM_SIZE      = $00000000;
  __ombCONFIG           = $1FC02FF0;
  __ombERASE_BLOCK_SIZE = $00000000;
  __ombWRITE_BLOCK_SIZE = $00000000;
{$ENDIF}
 
{$IFDEF P32MX775F256H}
  __ombFLASH_START      = $1D000000;
  __ombFLASH_SIZE       = $0003FFFF;
  __ombBOOTFLASH_START  = $1FC00000;
  __ombBOOTFLASH_SIZE   = $00002FEF;
  __ombEEPROM_START     = $00000000;
  __ombEEPROM_SIZE      = $00000000;
  __ombCONFIG           = $1FC02FF0;
  __ombERASE_BLOCK_SIZE = $00000000;
  __ombWRITE_BLOCK_SIZE = $00000000;
{$ENDIF}
 
{$IFDEF P32MX775F256L}
  __ombFLASH_START      = $1D000000;
  __ombFLASH_SIZE       = $0003FFFF;
  __ombBOOTFLASH_START  = $1FC00000;
  __ombBOOTFLASH_SIZE   = $00002FEF;
  __ombEEPROM_START     = $00000000;
  __ombEEPROM_SIZE      = $00000000;
  __ombCONFIG           = $1FC02FF0;
  __ombERASE_BLOCK_SIZE = $00000000;
  __ombWRITE_BLOCK_SIZE = $00000000;
{$ENDIF}
 
{$IFDEF P32MX775F512H}
  __ombFLASH_START      = $1D000000;
  __ombFLASH_SIZE       = $0007FFFF;
  __ombBOOTFLASH_START  = $1FC00000;
  __ombBOOTFLASH_SIZE   = $00002FEF;
  __ombEEPROM_START     = $00000000;
  __ombEEPROM_SIZE      = $00000000;
  __ombCONFIG           = $1FC02FF0;
  __ombERASE_BLOCK_SIZE = $00000000;
  __ombWRITE_BLOCK_SIZE = $00000000;
{$ENDIF}
 
{$IFDEF P32MX775F512L}
  __ombFLASH_START      = $1D000000;
  __ombFLASH_SIZE       = $0007FFFF;
  __ombBOOTFLASH_START  = $1FC00000;
  __ombBOOTFLASH_SIZE   = $00002FEF;
  __ombEEPROM_START     = $00000000;
  __ombEEPROM_SIZE      = $00000000;
  __ombCONFIG           = $1FC02FF0;
  __ombERASE_BLOCK_SIZE = $00000000;
  __ombWRITE_BLOCK_SIZE = $00000000;
{$ENDIF}
 
{$IFDEF P32MX795F512H}
  __ombFLASH_START      = $1D000000;
  __ombFLASH_SIZE       = $0007FFFF;
  __ombBOOTFLASH_START  = $1FC00000;
  __ombBOOTFLASH_SIZE   = $00002FEF;
  __ombEEPROM_START     = $00000000;
  __ombEEPROM_SIZE      = $00000000;
  __ombCONFIG           = $1FC02FF0;
  __ombERASE_BLOCK_SIZE = $00000000;
  __ombWRITE_BLOCK_SIZE = $00000000;
{$ENDIF}
 
{$IFDEF P32MX795F512L}
  __ombFLASH_START      = $1D000000;
  __ombFLASH_SIZE       = $0007FFFF;
  __ombBOOTFLASH_START  = $1FC00000;
  __ombBOOTFLASH_SIZE   = $00002FEF;
  __ombEEPROM_START     = $00000000;
  __ombEEPROM_SIZE      = $00000000;
  __ombCONFIG           = $1FC02FF0;
  __ombERASE_BLOCK_SIZE = $00000000;
  __ombWRITE_BLOCK_SIZE = $00000000;
{$ENDIF}
 
