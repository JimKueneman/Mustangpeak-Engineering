
{$DEFINE P16_SUPPORTS_ERASE}


{$IFDEF P16F610} {$UNDEF P16_SUPPORTS_ERASE} {$ENDIF}
{$IFDEF P16F616} {$UNDEF P16_SUPPORTS_ERASE} {$ENDIF}
{$IFDEF P16F627} {$UNDEF P16_SUPPORTS_ERASE} {$ENDIF}
{$IFDEF P16F627A} {$UNDEF P16_SUPPORTS_ERASE} {$ENDIF}
{$IFDEF P16F628} {$UNDEF P16_SUPPORTS_ERASE} {$ENDIF}
{$IFDEF P16F628A} {$UNDEF P16_SUPPORTS_ERASE} {$ENDIF}
{$IFDEF P16F630} {$UNDEF P16_SUPPORTS_ERASE} {$ENDIF}
{$IFDEF P16F636} {$UNDEF P16_SUPPORTS_ERASE} {$ENDIF}
{$IFDEF P16F639} {$UNDEF P16_SUPPORTS_ERASE} {$ENDIF}
{$IFDEF P16F648A} {$UNDEF P16_SUPPORTS_ERASE} {$ENDIF}
{$IFDEF P16F676} {$UNDEF P16_SUPPORTS_ERASE} {$ENDIF}
{$IFDEF P16F677} {$UNDEF P16_SUPPORTS_ERASE} {$ENDIF}
{$IFDEF P16F684} {$UNDEF P16_SUPPORTS_ERASE} {$ENDIF}
{$IFDEF P16F685} {$UNDEF P16_SUPPORTS_ERASE} {$ENDIF}
{$IFNDEF P16F687} {$UNDEF P16_SUPPORTS_ERASE} {$ENDIF}
{$IFDEF P16F688} {$UNDEF P16_SUPPORTS_ERASE} {$ENDIF}
{$IFDEF P16F689} {$UNDEF P16_SUPPORTS_ERASE} {$ENDIF}
{$IFDEF P16F690} {$UNDEF P16_SUPPORTS_ERASE} {$ENDIF}
{$IFDEF P16F707} {$UNDEF P16_SUPPORTS_ERASE} {$ENDIF}
{$IFDEF P16F716} {$UNDEF P16_SUPPORTS_ERASE} {$ENDIF}
{$IFDEF P16F72} {$UNDEF P16_SUPPORTS_ERASE} {$ENDIF}
{$IFDEF P16F720} {$UNDEF P16_SUPPORTS_ERASE} {$ENDIF}
{$IFDEF P16F721} {$UNDEF P16_SUPPORTS_ERASE} {$ENDIF}
{$IFDEF P16F722 {$UNDEF P16_SUPPORTS_ERASE} {$ENDIF}
{$IFDEF P16F722} {$UNDEF P16_SUPPORTS_ERASE} {$ENDIF}
{$IFDEF P16F723} {$UNDEF P16_SUPPORTS_ERASE} {$ENDIF}
{$IFDEF P16F723A} {$UNDEF P16_SUPPORTS_ERASE} {$ENDIF}
{$IFDEF P16F724} {$UNDEF P16_SUPPORTS_ERASE} {$ENDIF}
{$IFDEF P16F726} {$UNDEF P16_SUPPORTS_ERASE} {$ENDIF}
{$IFDEF P16F727} {$UNDEF P16_SUPPORTS_ERASE} {$ENDIF}
{$IFDEF P16F73} {$UNDEF P16_SUPPORTS_ERASE} {$ENDIF}
{$IFDEF P16F737} {$UNDEF P16_SUPPORTS_ERASE} {$ENDIF}
{$IFDEF P16F74} {$UNDEF P16_SUPPORTS_ERASE} {$ENDIF}
{$IFDEF P16F747} {$UNDEF P16_SUPPORTS_ERASE} {$ENDIF}
{$IFDEF P16F753} {$UNDEF P16_SUPPORTS_ERASE} {$ENDIF}
{$IFDEF P16F76} {$UNDEF P16_SUPPORTS_ERASE} {$ENDIF}
{$IFDEF P16F767} {$UNDEF P16_SUPPORTS_ERASE} {$ENDIF}
{$IFDEF P16F77} {$UNDEF P16_SUPPORTS_ERASE} {$ENDIF}
{$IFDEF P16F777} {$UNDEF P16_SUPPORTS_ERASE} {$ENDIF}
{$IFDEF P16F785} {$UNDEF P16_SUPPORTS_ERASE} {$ENDIF}
{$IFDEF P16F818} {$UNDEF P16_SUPPORTS_ERASE} {$ENDIF}
{$IFDEF P16F819} {$UNDEF P16_SUPPORTS_ERASE} {$ENDIF}
{$IFDEF P16F83} {$UNDEF P16_SUPPORTS_ERASE} {$ENDIF}
{$IFDEF P16F84} {$UNDEF P16_SUPPORTS_ERASE} {$ENDIF}
{$IFDEF P16F84A} {$UNDEF P16_SUPPORTS_ERASE} {$ENDIF}
{$IFDEF P16F87} {$UNDEF P16_SUPPORTS_ERASE} {$ENDIF}
{$IFDEF P16F870} {$UNDEF P16_SUPPORTS_ERASE} {$ENDIF}
{$IFDEF P16F871} {$UNDEF P16_SUPPORTS_ERASE} {$ENDIF}
{$IFDEF P16F872} {$UNDEF P16_SUPPORTS_ERASE} {$ENDIF}
{$IFDEF P16F873} {$UNDEF P16_SUPPORTS_ERASE} {$ENDIF}
{$IFDEF P16F873A} {$UNDEF P16_SUPPORTS_ERASE} {$ENDIF}
{$IFDEF P16F874} {$UNDEF P16_SUPPORTS_ERASE} {$ENDIF}
{$IFDEF P16F874A} {$UNDEF P16_SUPPORTS_ERASE} {$ENDIF}
{$IFDEF P16F876} {$UNDEF P16_SUPPORTS_ERASE} {$ENDIF}
{$IFDEF P16F876A} {$UNDEF P16_SUPPORTS_ERASE} {$ENDIF}
{$IFDEF P16F877} {$UNDEF P16_SUPPORTS_ERASE} {$ENDIF}
{$IFDEF P16F877A} {$UNDEF P16_SUPPORTS_ERASE} {$ENDIF}
{$IFDEF P16F88} {$UNDEF P16_SUPPORTS_ERASE} {$ENDIF}
{$IFDEF P16F882} {$UNDEF P16_SUPPORTS_ERASE} {$ENDIF}
{$IFDEF P16F883} {$UNDEF P16_SUPPORTS_ERASE} {$ENDIF}
{$IFDEF P16F884} {$UNDEF P16_SUPPORTS_ERASE} {$ENDIF}
{$IFDEF P16F886} {$UNDEF P16_SUPPORTS_ERASE} {$ENDIF}
{$IFDEF P16F887} {$UNDEF P16_SUPPORTS_ERASE} {$ENDIF}
{$IFDEF P16F913} {$UNDEF P16_SUPPORTS_ERASE} {$ENDIF}
{$IFDEF P16F914} {$UNDEF P16_SUPPORTS_ERASE} {$ENDIF}
{$IFDEF P16F916} {$UNDEF P16_SUPPORTS_ERASE} {$ENDIF}
{$IFDEF P16F917} {$UNDEF P16_SUPPORTS_ERASE} {$ENDIF}
{$IFDEF P16F946} {$UNDEF P16_SUPPORTS_ERASE} {$ENDIF}

